## conf/layer.conf
```bitbake
# We have a conf and classes directory, add to BBPATH
BBPATH .= ":${LAYERDIR}"

# We have recipes-* directories, add to BBFILES
BBFILES += "${LAYERDIR}/recipes-*/*/*.bb \
	${LAYERDIR}/recipes-*/*/*.bbappend"

BBFILE_COLLECTIONS += "inti"
BBFILE_PATTERN_inti = "^${LAYERDIR}/"
BBFILE_PRIORITY_inti = "21"

#LAYERDEPENDS_ea = "fsl-arm"
LAYERDEPENDS_inti = "fsl-arm"
LAYERDEPENDS_inti = "ea"
```
